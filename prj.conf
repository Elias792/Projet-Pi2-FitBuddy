## prj.conf
```kconfig
# Activation du log
CONFIG_LOG=y
CONFIG_LOG_DEFAULT_LEVEL=3

# Pile BLE générique (exemple). Pour du BLE Mesh, activer le stack Mesh.
CONFIG_BT=y
CONFIG_BT_PERIPHERAL=y

# I2C (ou I3C) pour le capteur
CONFIG_I2C=y

# Si vous utilisez le driver Zephyr du LSM6DSO 
# (exemple, en fonction de la version du SDK)
CONFIG_LSM6DSO=y

# Pile Thread ou autre protocole -> non requis ici
# ...
```

## src/main.c
```c
#include <zephyr.h>
#include <sys/printk.h>
#include <logging/log.h>
#include <stdio.h>
#include "sensor_lsm6dsox.h"
#include "rep_detection.h"
#include "ble_service.h"

LOG_MODULE_REGISTER(main, LOG_LEVEL_INF);

// Intervalle d'échantillonnage (en millisecondes) pour la lecture du capteur
#define SENSOR_READ_INTERVAL_MS  10  // ~100 Hz (à adapter selon vos besoins)

void main(void)
{
    int err;

    LOG_INF("FitBuddy (Priorité 1) - Démarrage du firmware");

    // 1. Initialisation du capteur IMU (LSM6DSOX)
    err = sensor_lsm6dsox_init();
    if (err) {
        LOG_ERR("Erreur init LSM6DSOX: %d", err);
        return;
    }

    // 2. Initialisation BLE (ou BLE Mesh)
    err = ble_service_init();
    if (err) {
        LOG_ERR("Erreur init BLE: %d", err);
        return;
    }

    // 3. Boucle principale
    while (1) {
        // Lecture IMU
        struct imu_data data;
        err = sensor_lsm6dsox_read(&data);
        if (err == 0) {
            // Détection et mise à jour des statistiques sur les répétitions
            update_repetition_stats(&data);

            // Récupération et affichage périodique des stats
            static uint32_t last_print_ms = 0;
            uint32_t now_ms = k_uptime_get_32();
            if ((now_ms - last_print_ms) >= 1000) {
                last_print_ms = now_ms;

                struct rep_stats stats = get_current_rep_stats();
                LOG_INF("Reps totales: %d - Reps serie: %d - Temps serie (ms): %u",
                        stats.total_reps, stats.current_reps, stats.current_series_time);
                LOG_INF("Vitesse moy. rep: %f - Amplitude moy.: %f",
                        stats.avg_speed, stats.avg_amplitude);

                // Transmission BLE (simple exemple, vous pouvez envoyer
                // la structure stats en notification)
                ble_service_send_rep_data(&stats);
            }
        }

        // Pause avant la prochaine lecture
        k_msleep(SENSOR_READ_INTERVAL_MS);
    }
}
```

## src/ble_service.c
```c
// ble_service.h
#ifndef BLE_SERVICE_H
#define BLE_SERVICE_H

#include "rep_detection.h"

#ifdef __cplusplus
extern "C" {
#endif

int ble_service_init(void);

// Exemple de fonction pour envoyer les données "rep_stats" en BLE
int ble_service_send_rep_data(const struct rep_stats *stats);

#ifdef __cplusplus
}
#endif

#endif // BLE_SERVICE_H
```

## src/rep_detection.c
```c
// rep_detection.c
#include "rep_detection.h"
#include <zephyr.h>
#include <math.h>
#include <logging/log.h>

LOG_MODULE_DECLARE(main);

// Paramètres de détection
#define ACC_THRESHOLD  1.2f // 1.2 g par ex. (à adapter)
#define MIN_REP_INTERVAL_MS 300  // On évite de détecter de fausses reps trop rapprochées

static struct rep_stats g_stats = {0};
static bool in_rep = false;
static uint32_t last_rep_time = 0;
static float speed_sum = 0.0f;
static float amplitude_sum = 0.0f;
static int rep_count_in_series = 0;

// On mémorise le temps de début de la série pour calculer la durée
static uint32_t series_start_time = 0;

// Fonction appelée par main()
void update_repetition_stats(const struct imu_data *data)
{
    // Calcul du vecteur accélération total (approx.)
    float accel_mag = sqrtf(data->accel_x * data->accel_x +
                            data->accel_y * data->accel_y +
                            data->accel_z * data->accel_z);

    // Estimation rapide de vitesse = dérivée d’accélération
    // (Ici simplifié: on peut se baser sur l’accel. instantanée comme "pseudo-speed")
    float speed_estimate = accel_mag; 

    // Vérifie si on dépasse un certain seuil => mouvement significatif
    bool rep_detected = (accel_mag >= ACC_THRESHOLD);

    uint32_t now_ms = k_uptime_get_32();

    // Initialisation si nouvelle série ?
    if (g_stats.current_reps == 0 && !in_rep) {
        // On considère qu’on commence une série
        series_start_time = now_ms;
    }

    if (rep_detected && !in_rep) {
        // Début d’une répétition
        // Vérifie qu’on n’a pas déjà compté une rep récemment
        if ((now_ms - last_rep_time) > MIN_REP_INTERVAL_MS) {
            in_rep = true;
            last_rep_time = now_ms;
            rep_count_in_series++;
        }
    } else if (!rep_detected && in_rep) {
        // Fin de la répétition
        in_rep = false;
        // Fin de la rep => actualise statistiques
        g_stats.total_reps++;
        g_stats.current_reps = rep_count_in_series;

        // On accumule la "vitesse" moyenne
        speed_sum += speed_estimate;
        // On accumule l’amplitude
        amplitude_sum += (accel_mag);

        // Possibilité de calculer un "niveau de difficulté" = ex. pic d’accélération
        // Dans l’exemple simplifié, on pourrait le logguer directement
        LOG_INF("Niveau de difficulté approx.: %f", accel_mag);
    }

    // Mise à jour temps de série
    if (rep_count_in_series > 0) {
        g_stats.current_series_time = (now_ms - series_start_time);
    } else {
        g_stats.current_series_time = 0;
    }

    // Exemple d’une détection de fin de série (pause trop longue)
    // => On réinitialise si plus de 3 secondes sans rep.
    // C’est l’occasion de calculer le temps de pause, etc.
    if (!in_rep && rep_count_in_series > 0) {
        if ((now_ms - last_rep_time) > 3000) {
            // Fin de série
            rep_count_in_series = 0;
            speed_sum = 0.0f;
            amplitude_sum = 0.0f;
        }
    }
}

struct rep_stats get_current_rep_stats(void)
{
    struct rep_stats stats_copy = g_stats;

    // Calcule la vitesse/amplitude moyennes sur la série en cours
    if (rep_count_in_series > 0) {
        stats_copy.avg_speed = speed_sum / (float)rep_count_in_series;
        stats_copy.avg_amplitude = amplitude_sum / (float)rep_count_in_series;
    } else {
        stats_copy.avg_speed = 0.0f;
        stats_copy.avg_amplitude = 0.0f;
    }

    return stats_copy;
}
```

## src/rep_detection.h
```c
// rep_detection.h
#ifndef REP_DETECTION_H
#define REP_DETECTION_H

#include "sensor_lsm6dsox.h"

#ifdef __cplusplus
extern "C" {
#endif

struct rep_stats {
    int total_reps;            // Nombre total de reps toutes séries confondues
    int current_reps;          // Nombre de reps dans la série en cours
    uint32_t current_series_time; // Durée de la série en millisecondes
    float avg_speed;           // Vitesse moyenne (simplifiée)
    float avg_amplitude;       // Amplitude moyenne
    // ... Ajoutez ce dont vous avez besoin
};

// A appeler périodiquement après chaque lecture IMU
void update_repetition_stats(const struct imu_data *data);

// Récupère l’état courant des stats
struct rep_stats get_current_rep_stats(void);

#ifdef __cplusplus
}
#endif

#endif // REP_DETECTION_H
```

## src/sensor_lsm6dsox.c
```c
// sensor_lsm6dsox.c
#include "sensor_lsm6dsox.h"
#include <zephyr.h>
#include <device.h>
#include <devicetree.h>
#include <drivers/i2c.h>
#include <logging/log.h>

LOG_MODULE_DECLARE(main, LOG_LEVEL_INF);

// Exemple: Nom du bus I2C défini dans le device tree (à adapter)
#define I2C_BUS DT_LABEL(DT_NODELABEL(i2c1))
// Adresse I2C (à vérifier selon config du capteur)
#define LSM6DSO_ADDR 0x6A  

static const struct device *i2c_dev;

// Exemple d’initialisation
int sensor_lsm6dsox_init(void)
{
    i2c_dev = device_get_binding(I2C_BUS);
    if (!i2c_dev) {
        LOG_ERR("I2C bus not found");
        return -ENODEV;
    }

    // Exemple d’écriture dans un registre pour activer l’IMU (ODR, range, etc.)
    // Registres LSM6DSOX à adapter selon la datasheet
    uint8_t config[2];
    int ret;

    // Exemple: CTRL1_XL = 0x10 -> 0x60 = ODR 416 Hz, ±2g
    config[0] = 0x10; 
    config[1] = 0x60; 
    ret = i2c_write(i2c_dev, config, 2, LSM6DSO_ADDR);
    if (ret) {
        LOG_ERR("Failed to configure ACC");
        return ret;
    }

    // Exemple: CTRL2_G = 0x11 -> 0x60 = ODR 416 Hz, 2000 dps
    config[0] = 0x11; 
    config[1] = 0x60; 
    ret = i2c_write(i2c_dev, config, 2, LSM6DSO_ADDR);
    if (ret) {
        LOG_ERR("Failed to configure GYRO");
        return ret;
    }

    LOG_INF("LSM6DSOX initialized");
    return 0;
}

// Lecture basique (accel + gyro)
int sensor_lsm6dsox_read(struct imu_data *out)
{
    uint8_t data[12];
    int ret;

    // Les registres OUTX_L_G (0x22) à OUTZ_H_XL (0x2D) -> 12 octets
    // 2 octets par axe gyro X/Y/Z, puis 2 octets par axe accel X/Y/Z
    // Dans un ordre à vérifier selon la doc du LSM6DSO(X).
    const uint8_t start_reg = 0x22;
    ret = i2c_write_read(i2c_dev, LSM6DSO_ADDR, &start_reg, 1, data, 12);
    if (ret) {
        LOG_ERR("Error reading LSM6DSOX data");
        return ret;
    }

    // Conversion brute -> float ; coefficients à adapter
    // Gyro dps/LSB et Acc mg/LSB (exemples approximatifs)
    int16_t gx_raw = (int16_t)((data[1] << 8) | data[0]);
    int16_t gy_raw = (int16_t)((data[3] << 8) | data[2]);
    int16_t gz_raw = (int16_t)((data[5] << 8) | data[4]);

    int16_t ax_raw = (int16_t)((data[7] << 8) | data[6]);
    int16_t ay_raw = (int16_t)((data[9] << 8) | data[8]);
    int16_t az_raw = (int16_t)((data[11] << 8) | data[10]);

    // Facteurs de conversion approximatifs (à ajuster en fonction de la config)
    const float gyro_sensitivity = 70.0f / 1000.0f;   // ex. 70 mdps/LSB -> 0.07 dps/LSB
    const float accel_sensitivity = 0.061f;          // ex. 0.061 mg/LSB -> 0.000061 g/LSB

    out->gyro_x  = gx_raw * gyro_sensitivity;
    out->gyro_y  = gy_raw * gyro_sensitivity;
    out->gyro_z  = gz_raw * gyro_sensitivity;

    out->accel_x = ax_raw * accel_sensitivity;
    out->accel_y = ay_raw * accel_sensitivity;
    out->accel_z = az_raw * accel_sensitivity;

    return 0;
}
```

## src/sensor_lsm6dsox.h
```c
// sensor_lsm6dsox.h
#ifndef SENSOR_LSM6DSOX_H
#define SENSOR_LSM6DSOX_H

#include <zephyr/types.h>

#ifdef __cplusplus
extern "C" {
#endif

struct imu_data {
    float accel_x;
    float accel_y;
    float accel_z;
    float gyro_x;
    float gyro_y;
    float gyro_z;
};

int sensor_lsm6dsox_init(void);
int sensor_lsm6dsox_read(struct imu_data *out);

#ifdef __cplusplus
}
#endif

#endif // SENSOR_LSM6DSOX_H
```
